## Kconfig
```kconfig
menuconfig ESP_HOSTED
	bool "ESP-Hosted"
	default n if ESP_HOST_WIFI_ENABLED
	default n if ESP_WIFI_REMOTE_ENABLED && !ESP_WIFI_REMOTE_LIBRARY_HOSTED
	default y if ESP_WIFI_REMOTE_ENABLED && ESP_WIFI_REMOTE_LIBRARY_HOSTED
	default y

if ESP_HOSTED

	choice ESP_HOSTED_ROLE
		prompt "Use this device as (Coprocessor/Host)"
		default ESP_HOSTED_HOST
		help
			Select whether this build is for the host or the coprocessor.
			Hosted IDF apps almost always want the Host role; CP firmware
			projects set CONFIG_ESP_HOSTED_CP=y in their sdkconfig.defaults.

		config ESP_HOSTED_HOST
			bool "Host"

		config ESP_HOSTED_CP
			bool "Coprocessor (CP)"
	endchoice

	orsource "common/eh_common/Kconfig.ext"

	if ESP_HOSTED_CP
		orsource "coprocessor/Kconfig.ext"
	endif

	if ESP_HOSTED_HOST
		orsource "host/Kconfig.ext"
	endif

endif

# Component Manager reads sdkconfig.json. The USB stack symbols are omitted
# when the USB menu is inactive, and a hidden bool that is n is omitted too.
# These ints are written for every build, including when the value is 0.
config ESP_HOSTED_HOST_USB_CDC_ACM_MANIFEST
	int
	default 1 if ESP_HOSTED_HOST_USB_STACK_CDC_ACM && !ESP_HOSTED_HOST_USB_RNDIS
	default 0

config ESP_HOSTED_HOST_USB_RNDIS_MANIFEST
	int
	default 1 if ESP_HOSTED_HOST_USB_RNDIS
	default 0

config ESP_HOSTED_HOST_USB_CHERRYUSB_MANIFEST
	int
	default 1 if ESP_HOSTED_HOST_USB_STACK_CHERRYUSB
	default 0

config ESP_HOSTED_CP_TINYUSB_MANIFEST
	int
	default 1 if EH_TRANSPORT_CP_USB_OTG_DEVICE
	default 0
```

## common/eh_common/Kconfig.ext
```kconfig
menu "Common config (Host & Coprocessor)"
	depends on ESP_HOSTED

	config ESP_HOSTED_AUTO_CALL_INIT_BEFORE_APP_MAIN
		bool "Start ESP-Hosted automatically"
		default y
		help
			y: ESP-Hosted starts by itself.
			Host: the first hosted call, for example esp_wifi_init(), starts
			the link and waits until it is up.
			Coprocessor: ESP-Hosted starts before app_main().

			n: the app calls esp_hosted_init() and
			esp_hosted_connect_to_slave().

endmenu
```

## coprocessor/features/eh_cp_feat_phy_ant/Kconfig.ext
```kconfig
menuconfig ESP_HOSTED_CP_FEAT_PHY_ANT
	bool "PHY antenna selection"
	depends on ESP_HOSTED_CP
	default n
	help
		Lets the host configure an external antenna switch on coprocessor
		GPIOs (esp_phy_set_ant_gpio / esp_phy_set_ant) over RPC.
		Antenna selection is PHY-level and applies to every radio.
		GPIOs owned by the active transport are refused.

if ESP_HOSTED_CP_FEAT_PHY_ANT

	config ESP_HOSTED_CP_FEAT_PHY_ANT_READY
		bool
		default y

	config ESP_HOSTED_CP_FEAT_PHY_ANT_AUTO_INIT
		bool "Auto-initialise PHY antenna selection at boot"
		default y if ESP_HOSTED_CP_FEAT_PHY_ANT_READY && ESP_HOSTED_CP_AUTO_FEAT_INIT
		default n
		depends on ESP_HOSTED_CP_AUTO_FEAT_INIT
		help
			When enabled, PHY antenna selection auto-initialises during
			eh_cp_init().  Disable to manually call the init from app code.

	config ESP_HOSTED_CP_FEAT_PHY_ANT_IDF_GPIO_RSV_WORKAROUND
		bool "Work around the ESP-IDF antenna GPIO reservation check"
		default n
		help
			ESP-IDF esp_phy_set_ant_gpio() passes the GPIO number to
			esp_gpio_is_reserved(), which expects a GPIO bit mask. The check
			then tests the wrong GPIOs: a free GPIO can be refused, and
			re-applying the same antenna configuration can fail.

			Enable this only if your ESP-IDF does not have the fix. The
			coprocessor then releases the GPIOs that the wrong check tests,
			for the duration of the IDF call only. A reserved GPIO is always
			refused, with or without this option.

endif # ESP_HOSTED_CP_FEAT_PHY_ANT
```

## examples/bluetooth/bluedroid_uart/bluedroid_host_only_uart/mcu_host/main/Kconfig.projbuild
```kconfig
menu "Example Configuration"
    config EXAMPLE_HCI_UART_BAUDRATE
        int "UART Baudrate for HCI"
        range 115200 921600
        default 921600
        help
            UART Baudrate for HCI. Please use standard baudrate.

    config EXAMPLE_HCI_UART_TX_PIN
        int "UART Tx Pin"
        default 5

    config EXAMPLE_HCI_UART_RX_PIN
        int "UART Rx Pin"
        default 18

    config EXAMPLE_HCI_UART_FLOW_CTRL_EN
        bool "UART hardware flow control (RTS/CTS)"
        default y

    config EXAMPLE_HCI_UART_RTS_PIN
        int "UART Rts Pin"
        depends on EXAMPLE_HCI_UART_FLOW_CTRL_EN
        default 19

    config EXAMPLE_HCI_UART_CTS_PIN
        int "UART Cts Pin"
        depends on EXAMPLE_HCI_UART_FLOW_CTRL_EN
        default 23
endmenu
```

## examples/host_framework_iperf_validation/main/Kconfig.projbuild
```kconfig
menu "Example Configuration"

config EXAMPLE_HOSTED_CONNECT_TIMEOUT_MS
    int "Hosted connect timeout (ms)"
    range 1000 60000
    default 15000
    help
        Timeout used while waiting for ESP_HOSTED_EVENT_TRANSPORT_UP and
        ESP_HOSTED_EVENT_CP_INIT after esp_hosted_connect_to_slave().

config EXAMPLE_SOFTAP_START_TIMEOUT_MS
    int "SoftAP start timeout (ms)"
    range 1000 60000
    default 10000
    help
        Timeout used while waiting for WIFI_EVENT_AP_START.

config EXAMPLE_SOFTAP_SSID
    string "SoftAP SSID"
    default "ESP32_IPERF"

config EXAMPLE_SOFTAP_PASSWORD
    string "SoftAP password"
    default "12345678"
    help
        Leave empty to start an open SoftAP.

config EXAMPLE_SOFTAP_CHANNEL
    int "SoftAP channel"
    range 1 13
    default 1

config EXAMPLE_SOFTAP_MAX_CONN
    int "SoftAP max connections"
    range 1 10
    default 2

config EXAMPLE_ENABLE_IPERF_REMOTE_CONTROL
    bool "Enable iperf remote control service"
    default y
    help
        Starts a small TCP server on port 22336 for simple automation.

endmenu
```

## examples/host_framework_iperf_validation/sdkconfig.defaults
```kconfig
CONFIG_ESP_HOSTED_ENABLED=y
CONFIG_ESP_HOSTED_SDIO_HOST_INTERFACE=y
CONFIG_ESP_HOSTED_SDIO_BUS_WIDTH=4
CONFIG_ESP_HOSTED_SDIO_CLOCK_FREQ_KHZ=40000
CONFIG_ESP_HOSTED_SDIO_TX_Q_SIZE=20
CONFIG_ESP_HOSTED_SDIO_RX_Q_SIZE=20
CONFIG_ESP_HOSTED_GPIO_SLAVE_RESET_SLAVE=54
CONFIG_ESP_HOSTED_TRANSPORT_RESTART_ON_FAILURE=n

CONFIG_ESP_WIFI_ENABLED=y
CONFIG_ESP_SYSTEM_EVENT_TASK_STACK_SIZE=4096
CONFIG_FREERTOS_HZ=1000

CONFIG_LWIP_IRAM_OPTIMIZATION=y
CONFIG_LWIP_TCPIP_TASK_PRIO=23

CONFIG_IPERF_TRAFFIC_TASK_PRIORITY=23
CONFIG_IPERF_REPORT_TASK_PRIORITY=24
CONFIG_COMPILER_OPTIMIZATION_PERF=y
CONFIG_PARTITION_TABLE_SINGLE_APP_LARGE=y

CONFIG_LOG_DEFAULT_LEVEL_INFO=y
```

## examples/host_framework_validation/main/Kconfig.projbuild
```kconfig
menu "Example Configuration"

	config EXAMPLE_VALIDATION_CYCLES
		int "Validation cycle count"
		range 1 20
		default 2
		help
			Number of explicit init/connect/deinit cycles to execute.

	config EXAMPLE_CONNECT_TIMEOUT_MS
		int "Connect wait timeout (ms)"
		range 1000 60000
		default 12000
		help
			Maximum time to wait for both CP_INIT and TRANSPORT_UP events.

	config EXAMPLE_CYCLE_DELAY_MS
		int "Delay between validation cycles (ms)"
		range 0 10000
		default 1000
		help
			Delay inserted after deinit before starting the next cycle.

	config EXAMPLE_QUERY_FW_VERSION
		bool "Query firmware version after connect"
		default y
		help
			Try the optional firmware-version RPC after transport comes up.
			Old factory slave firmware may not support it, which is logged as a warning only.

endmenu
```

## examples/host_framework_validation/sdkconfig.defaults
```kconfig
CONFIG_ESP_HOSTED_ENABLED=y
CONFIG_ESP_HOSTED_SDIO_HOST_INTERFACE=y
CONFIG_ESP_HOSTED_SDIO_BUS_WIDTH=4
CONFIG_ESP_HOSTED_SDIO_CLOCK_FREQ_KHZ=40000
CONFIG_ESP_HOSTED_SDIO_TX_Q_SIZE=20
CONFIG_ESP_HOSTED_SDIO_RX_Q_SIZE=20
CONFIG_ESP_HOSTED_GPIO_SLAVE_RESET_SLAVE=54
CONFIG_ESP_HOSTED_TRANSPORT_RESTART_ON_FAILURE=n

CONFIG_ESP_WIFI_ENABLED=y
CONFIG_FREERTOS_HZ=1000

CONFIG_LOG_DEFAULT_LEVEL_INFO=y
```

## examples/host_gpio_expander/sdkconfig.defaults
```kconfig
# ESP-Hosted GPIO Expander Example Configuration

# Enable GPIO expander support
CONFIG_ESP_HOSTED_ENABLE_GPIO_EXPANDER=y
CONFIG_FREERTOS_HZ=1000
```

## examples/host_hosted_cp_meminfo/sdkconfig.defaults
```kconfig
# enable mem monitor configuration
CONFIG_ESP_HOSTED_MEM_MONITOR=y
CONFIG_FREERTOS_HZ=1000
```

## examples/host_openthread_border_router/sdkconfig.defaults
```kconfig
####
# Settings copied from https://github.com/espressif/esp-idf/tree/master/examples/openthread/ot_br
####

#
# Partition Table
#
CONFIG_PARTITION_TABLE_CUSTOM=y
CONFIG_PARTITION_TABLE_CUSTOM_FILENAME="partitions.csv"
CONFIG_PARTITION_TABLE_FILENAME="partitions.csv"
CONFIG_PARTITION_TABLE_MD5=y
# end of Partition Table

#
# mbedTLS
#
CONFIG_MBEDTLS_SSL_PROTO_DTLS=y
CONFIG_MBEDTLS_KEY_EXCHANGE_ECJPAKE=y
# end of TLS Key Exchange Methods

CONFIG_MBEDTLS_ECJPAKE_C=y
# end of mbedTLS

#
# OpenThread
#
CONFIG_OPENTHREAD_ENABLED=y
CONFIG_OPENTHREAD_BORDER_ROUTER=y
CONFIG_OPENTHREAD_RADIO_SPINEL_UART=y
CONFIG_OPENTHREAD_TASK_SIZE=8192
CONFIG_OPENTHREAD_CONSOLE_ENABLE=n
# end of OpenThread

#
# lwIP
#
CONFIG_LWIP_IPV6_FORWARD=y
CONFIG_LWIP_IPV6_NUM_ADDRESSES=12
CONFIG_LWIP_MULTICAST_PING=y
CONFIG_LWIP_NETIF_STATUS_CALLBACK=y
CONFIG_LWIP_HOOK_IP6_ROUTE_DEFAULT=y
CONFIG_LWIP_HOOK_ND6_GET_GW_DEFAULT=y
CONFIG_LWIP_HOOK_IP6_INPUT_CUSTOM=y
CONFIG_LWIP_HOOK_IP6_SELECT_SRC_ADDR_CUSTOM=y
CONFIG_LWIP_IPV6_AUTOCONFIG=y
# end of lwIP

#
# mDNS
#
CONFIG_MDNS_MULTIPLE_INSTANCE=y
# end of mDNS

# Example connect
CONFIG_EXAMPLE_CONNECT_THREAD=n

#
# ESP System Settings
#
CONFIG_ESP_SYSTEM_EVENT_TASK_STACK_SIZE=3584
CONFIG_ESP_MAIN_TASK_STACK_SIZE=6144
# end of ESP System Settings

#
# Serial flasher config
#
CONFIG_ESPTOOLPY_FLASHSIZE_4MB=y

### SW coexistence on the co-processor is on, so this option must be
### disabled on host to keep OpenThread capabilities consistent
CONFIG_OPENTHREAD_RX_ON_WHEN_IDLE=n

### enable ESP-Hosted OpenThread Support
CONFIG_ESP_HOSTED_HOST_OT_ENABLE=y
CONFIG_FREERTOS_HZ=1000
```

## examples/host_openthread_cli/sdkconfig.defaults
```kconfig
####
# Settings copied from https://github.com/espressif/esp-idf/tree/master/examples/openthread/ot_cli
####

#
# Partition Table
#
CONFIG_PARTITION_TABLE_CUSTOM=y
CONFIG_PARTITION_TABLE_CUSTOM_FILENAME="partitions.csv"
CONFIG_PARTITION_TABLE_FILENAME="partitions.csv"
CONFIG_PARTITION_TABLE_OFFSET=0x8000
CONFIG_PARTITION_TABLE_MD5=y
# end of Partition Table

#
# mbedTLS
#
CONFIG_MBEDTLS_SSL_PROTO_DTLS=y
CONFIG_MBEDTLS_KEY_EXCHANGE_ECJPAKE=y
CONFIG_MBEDTLS_ECJPAKE_C=y
# end of mbedTLS

#
# OpenThread
#
CONFIG_OPENTHREAD_ENABLED=y
CONFIG_OPENTHREAD_BORDER_ROUTER=n
CONFIG_OPENTHREAD_DNS64_CLIENT=y
CONFIG_OPENTHREAD_TASK_SIZE=10240
CONFIG_OPENTHREAD_CONSOLE_ENABLE=n
# end of OpenThread

#
# lwIP
#
CONFIG_LWIP_TCPIP_TASK_STACK_SIZE=4096
CONFIG_LWIP_IPV6_NUM_ADDRESSES=8
CONFIG_LWIP_MULTICAST_PING=y
CONFIG_LWIP_HOOK_IP6_SELECT_SRC_ADDR_CUSTOM=y
# end of lwIP

#
# ESP System Settings
#
CONFIG_ESP_MAIN_TASK_STACK_SIZE=6144
# end of ESP System Settings

### SW coexistence on the co-processor is on, so this option must be
### disabled on host to keep OpenThread capabilities consistent
CONFIG_OPENTHREAD_RX_ON_WHEN_IDLE=n

### enable ESP-Hosted OpenThread Support
CONFIG_ESP_HOSTED_HOST_OT_ENABLE=y
CONFIG_FREERTOS_HZ=1000
```

## examples/host_zigbee_thermostat/sdkconfig.defaults
```kconfig
#
# Partition Table
#
CONFIG_PARTITION_TABLE_CUSTOM=y
CONFIG_PARTITION_TABLE_CUSTOM_FILENAME="partitions.csv"
# end of Partition Table

#
# Zigbee
#
CONFIG_ZB_ENABLED=y
# end of Zigbee

### enable ESP-Hosted Zigbee Support
CONFIG_ESP_HOSTED_HOST_OT_ENABLE=y
CONFIG_FREERTOS_HZ=1000
```
