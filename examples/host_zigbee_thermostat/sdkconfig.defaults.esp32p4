## examples/network_split/iperf/mcu_host/main/Kconfig.projbuild
```kconfig
menu "ESP-Hosted Example Config"
	choice EXAMPLE_APP_STA_NETIF
		prompt "When the app creates WIFI_STA_DEF (relative to esp_hosted_init)"
		default EXAMPLE_APP_STA_NETIF_BEFORE_HOSTED_INIT
		help
			The app creates WIFI_STA_DEF before or after esp_hosted_init(), or
			not at all.

		config EXAMPLE_APP_STA_NETIF_BEFORE_HOSTED_INIT
			bool "Before esp_hosted_init()"
		config EXAMPLE_APP_STA_NETIF_AFTER_HOSTED_INIT
			bool "After esp_hosted_init()"
		config EXAMPLE_APP_STA_NETIF_NONE
			bool "Never"
	endchoice

	choice EXAMPLE_BOOT_WIFI
		prompt "Test hook: Wi-Fi calls the app makes at boot"
		default EXAMPLE_BOOT_WIFI_INIT_START
		help
			Test use: an app that makes fewer Wi-Fi calls at boot. The console's
			wifi commands do the rest.

		config EXAMPLE_BOOT_WIFI_INIT_START
			bool "esp_wifi_init + esp_wifi_start"
		config EXAMPLE_BOOT_WIFI_INIT
			bool "esp_wifi_init only"
		config EXAMPLE_BOOT_WIFI_NONE
			bool "None"
	endchoice

	config EXAMPLE_NW_SPLIT_ECHO_SERVER
		bool "Run a TCP echo server on the host stack (network-split routing test)"
		default n
		help
			Start a TCP echo server on the host stack at ECHO_PORT (a host
			port-range port). A client reaching it proves the 802.3 split routed
			that port class to the host; CP-local ports go to the coprocessor.
			Off by default — enabled by the network-split routing test.

	config EXAMPLE_NW_SPLIT_ECHO_PORT
		int "Host echo server TCP port"
		depends on EXAMPLE_NW_SPLIT_ECHO_SERVER
		default 49999
		help
			Must lie in the host port range (49152-61439) so the split routes it
			to the host stack.

	menu "Example to run"
		depends on ESP_HOSTED_CP_EXT_NW_SPLIT

		config ESP_HOSTED_CP_EXAMPLE_MQTT_CLIENT
			bool "MQTT client example"
			default n

		menu "MQTT client config"
			depends on ESP_HOSTED_CP_EXAMPLE_MQTT_CLIENT

			choice BROKER_CHOICE
				prompt "MQTT Broker"
				default BROKER_HIVEMQ

				config BROKER_ECLIPSEPROJECTS
					bool "mqtt.eclipseprojects.io"
				config BROKER_HIVEMQ
					bool "broker.hivemq.com"
			endchoice

			config BROKER_URL
				string
				default "mqtt://mqtt.eclipseprojects.io" if BROKER_ECLIPSEPROJECTS
				default "mqtt://broker.hivemq.com" if BROKER_HIVEMQ
				help
					URL of the broker to connect to

			config BROKER_URL_FROM_STDIN
				bool
				default y if BROKER_URL = "FROM_STDIN"

		endmenu

		config ESP_HOSTED_CP_EXAMPLE_HTTP_CLIENT
			bool "HTTP client example"
			default n

		menu "HTTP client config"
			depends on ESP_HOSTED_CP_EXAMPLE_HTTP_CLIENT

			config HTTP_WEBSERVER
				string "HTTP webserver to send req"
				default "example.com"

			config HTTP_WEBSERVER_PORT
				string "HTTP webserver port"
				default "80"

			config HTTP_WEBSERVER_PATH
				string "HTTP webserver path"
				default "/"

			config HTTP_REQ_DELAY
				int "Delay after every http request (seconds)"
				default 10

		endmenu
	endmenu
endmenu
```

## examples/openthread/rcp_on_hosted_cp/border_router/esp_host/main/Kconfig.projbuild
```kconfig
menu "Example Configuration"
    choice EXAMPLE_SPINEL_LINK
        prompt "Spinel link to the RCP"
        default EXAMPLE_SPINEL_LINK_HOSTED
        help
            ESP-Hosted transport: spinel goes as ESP_AUX_IF frames on the ESP-Hosted bus.
            It needs the ESP-IDF OpenThread custom transport, ESP-IDF commit 8c87790e47
            (master and release/v6.2; not in v6.1 or older). Without it the build stops.
            Dedicated UART: standard OpenThread on two extra wires, any ESP-IDF.
        config EXAMPLE_SPINEL_LINK_HOSTED
            bool "ESP-Hosted transport (ESP_AUX_IF)"
        config EXAMPLE_SPINEL_LINK_UART
            bool "Dedicated UART"
    endchoice

    menu "Dedicated spinel UART"
        depends on OPENTHREAD_RADIO_SPINEL_UART

        config EXAMPLE_HOST_UART_PORT
            int "Host UART port to the RCP"
            range 0 2
            default 1

        config EXAMPLE_HOST_UART_TX_PIN
            int "Host TX pin -> RCP RX"
            range -1 63
            default -1
            help
                -1 means not set: the build then fails with a message.

        config EXAMPLE_HOST_UART_RX_PIN
            int "Host RX pin <- RCP TX"
            range -1 63
            default -1
            help
                -1 means not set: the build then fails with a message.

        config EXAMPLE_HOST_UART_BAUDRATE
            int "Spinel UART baud rate"
            default 460800
            help
                Must be the same as EXAMPLE_RCP_UART_BAUDRATE on the co-processor.

    endmenu

endmenu
```

## examples/openthread/rcp_on_hosted_cp/cli/cp/main/Kconfig.projbuild
```kconfig
menu "Example Configuration"

    menu "Dedicated spinel UART"
        depends on OPENTHREAD_RCP_UART

        config EXAMPLE_RCP_UART_PORT
            int "RCP UART port to the host"
            range 0 2
            default 1
            help
                Must not be the ESP-Hosted UART transport port.

        config EXAMPLE_RCP_UART_TX_PIN
            int "RCP TX pin -> host RX"
            range -1 63
            default -1
            help
                -1 means not set: the build then fails with a message.

        config EXAMPLE_RCP_UART_RX_PIN
            int "RCP RX pin <- host TX"
            range -1 63
            default -1
            help
                -1 means not set: the build then fails with a message.

        config EXAMPLE_RCP_UART_BAUDRATE
            int "Spinel UART baud rate"
            default 460800
            help
                Must be the same as EXAMPLE_HOST_UART_BAUDRATE on the host.

    endmenu

endmenu
```

## examples/openthread/rcp_separate_chip/border_router/cp_rcp/main/Kconfig.projbuild
```kconfig
menu "OpenThread RCP Example"

    config EXAMPLE_RCP_UART_PIN_MANUAL
        bool "Configure RCP UART pin manually"
        default n
        help
            Select this to choose UART pin manually

    config EXAMPLE_RCP_UART_RX_PIN
        int "The number of RX pin"
        depends on EXAMPLE_RCP_UART_PIN_MANUAL
        default 4
        range 0 25

    config EXAMPLE_RCP_UART_TX_PIN
        int "The number of TX pin"
        depends on EXAMPLE_RCP_UART_PIN_MANUAL
        default 5
        range 0 25

endmenu
```

## examples/openthread/rcp_separate_chip/border_router/esp_host/main/Kconfig.projbuild
```kconfig
menu "OpenThread Border Router Example"

    config EXAMPLE_HOST_UART_PORT
        int "Host UART port to the RCP"
        range 0 2
        default 1

    config EXAMPLE_HOST_UART_TX_PIN
        int "Host TX pin -> RCP RX"
        range 0 63
        default 4

    config EXAMPLE_HOST_UART_RX_PIN
        int "Host RX pin <- RCP TX"
        range 0 63
        default 6

    config EXAMPLE_HOST_UART_BAUDRATE
        int "Spinel UART baud rate"
        default 460800
        help
            Must be the same as the baud rate of the RCP firmware (cp_rcp/).

    config EXAMPLE_RCP_RESET_PIN
        int "Host GPIO to the RCP reset input (-1: no hardware reset)"
        range -1 63
        default -1
        help
            Host GPIO connected to the reset input of the RCP. When OpenThread
            reports an RCP failure, the host pulls this GPIO low for 10 ms.
            Set -1 if no reset wire is connected: the host logs a warning
            at boot and runs without hardware reset.

endmenu
```

## examples/rf_cert/mcu_host/main/Kconfig.projbuild
```kconfig
menu "RF certification test example"

config RF_CERT_EXAMPLE_INTEGRATED_OTA
	bool "Integrate coprocessor OTA (phy_cert_cp_ota)"
	default n
	help
	  Carries a coprocessor image in a LittleFS partition on the host and
	  streams it to the coprocessor over the hosted link.

	  Use it to put production firmware on a coprocessor whose own UART is
	  not reachable, once certification is done.

	  Off, none of it is built and the LittleFS dependency is not even
	  fetched; phy_cert_cp_ota still answers, with the steps to turn it on.

	  sdkconfig.defaults.ota sets this and the partition table it needs.

if RF_CERT_EXAMPLE_INTEGRATED_OTA

config RF_CERT_EXAMPLE_OTA_REPORT_VERSION
	bool "Report both firmware versions before sending"
	default y
	help
	  Reads the project name and version out of the staged image's app
	  descriptor and prints them next to what the coprocessor is running,
	  so an operator can see which image is about to replace which.

config RF_CERT_EXAMPLE_OTA_SKIP_IF_SAME
	bool "Skip the update when the staged image matches what is running"
	depends on RF_CERT_EXAMPLE_OTA_REPORT_VERSION
	default y
	help
	  Compares the staged image's version against the coprocessor's and
	  does nothing if they are equal, so repeating the command does not
	  reflash the same firmware.

	  Turn this off to send the image regardless — useful when the version
	  string does not change between builds.

endif

endmenu
```

## examples/system/mcu_transport_config/mcu_host/main/Kconfig.projbuild
```kconfig
menu "Example Configuration"

    config EXAMPLE_MANUAL_ENABLE_WIFI_STA
        bool "Stage 2: bring up Wi-Fi STA"
        default y
        help
            After the hosted link is up, manually init the host Wi-Fi feature and
            connect a station to obtain an IP. Disable to demonstrate transport
            configuration + core link only.

    config EXAMPLE_WIFI_SSID
        string "Wi-Fi SSID"
        default "myssid"
        help
            SSID the STA connects to (defaults match the emulator SoftAP).

    config EXAMPLE_WIFI_PASSWORD
        string "Wi-Fi password"
        default "mypassword"

    config EXAMPLE_MANUAL_ENABLE_BLE_ADV
        bool "Stage 3: bring up BLE advertising"
        default y
        help
            After the hosted link is up, set up the NimBLE host over the hosted HCI
            (controller on the coprocessor) and start advertising. Disable to skip BLE.

endmenu
```

## examples/wifi/iperf/cp/sdkconfig.defaults.esp32s31.usb_cdc
```kconfig
# Partition Table
#----------------
CONFIG_PARTITION_TABLE_CUSTOM=y
CONFIG_PARTITION_TABLE_CUSTOM_FILENAME="partitions_eh_cp_ota_4m.csv"

# Transport config
# Default is to use USB OTG Device as transport
#-----------------
CONFIG_EH_TRANSPORT_CP_USB_OTG_DEVICE=y

# TinyUSB config
#---------------
# CDC-ACM Configuration
CONFIG_TINYUSB_CDC_ENABLED=y
CONFIG_TINYUSB_CDC_RX_BUFSIZE=2048
CONFIG_TINYUSB_CDC_TX_BUFSIZE=2048
CONFIG_TINYUSB_CDC_EP_BUFSIZE=2048
```

## examples/zigbee/thermostat/esp_host/main/Kconfig.projbuild
```kconfig
menu "Example Configuration"
    config EXAMPLE_GPIO_BOOT_ON_DEVKIT
        int "BOOT GPIO on devkit"
        default 9 if IDF_TARGET_ESP32H2
        default 35 if IDF_TARGET_ESP32P4
        default 9

        help
            The GPIO connected to the BOOT button on the devkits

    config EXAMPLE_HOST_UART_PORT
        int "Host UART port to the RCP"
        range 0 2
        default 1

    config EXAMPLE_HOST_UART_TX_PIN
        int "Host TX pin -> RCP RX"
        range -1 63
        default -1
        help
            -1 means not set: the build then fails with a message.

    config EXAMPLE_HOST_UART_RX_PIN
        int "Host RX pin <- RCP TX"
        range -1 63
        default -1
        help
            -1 means not set: the build then fails with a message.

    config EXAMPLE_HOST_UART_BAUDRATE
        int "Spinel UART baud rate"
        default 460800
        help
            Must be the same as EXAMPLE_RCP_UART_BAUDRATE on the co-processor.

endmenu
```

## host/features/eh_host_feat_openthread/Kconfig.ext
```kconfig
menuconfig ESP_HOSTED_HOST_FEAT_OPENTHREAD
	bool "OpenThread RCP on the co-processor (spinel over ESP-Hosted)"
	default n
	depends on ESP_HOSTED_HOST && ESP_HOSTED_HOST_FEAT_RPC
	depends on ESP_HOSTED_HOST_FEAT_RPC_EXT_V2_READY
	depends on ESP_HOSTED_HOST_TYPE_MCU
	help
	  OpenThread RCP on the co-processor, with spinel over the
	  ESP-Hosted transport as ESP_AUX_IF frames. The host drives
	  init / deinit / start / stop / query of the RCP over
	  RpcReqFeatureControl.

	  Needs an ESP-IDF that has the OpenThread custom transport, with
	  CONFIG_OPENTHREAD_RADIO_SPINEL_CUSTOM=y.

	  For spinel on a dedicated UART, leave this off: the app sets a
	  UART radio config, as ESP-IDF examples/openthread/ot_cli does.

if ESP_HOSTED_HOST_FEAT_OPENTHREAD

	config ESP_HOSTED_HOST_FEAT_OPENTHREAD_AUTO_INIT
		bool "Auto-initialize OpenThread feature at boot"
		default y
		depends on ESP_HOSTED_HOST_AUTO_FEAT_INIT

	config ESP_HOSTED_OT_HOST_HOSTED_RX_QUEUE_LEN
		int "Spinel receive queue length (frames)"
		default 16
		range 4 64
		help
			Number of spinel frames from the co-processor that can wait
			until the OpenThread task reads them. Each queued frame holds
			up to 1 KB of heap. When the queue is full, a received frame
			is dropped and OpenThread retries it.

endif # ESP_HOSTED_HOST_FEAT_OPENTHREAD

config ESP_HOSTED_HOST_FEAT_OPENTHREAD_READY
	bool
	default y if ESP_HOSTED_HOST_FEAT_OPENTHREAD && \
	             ESP_HOSTED_HOST_FEAT_RPC_READY && \
	             ESP_HOSTED_HOST_FEAT_RPC_EXT_V2_READY && \
	             OPENTHREAD_ENABLED && OPENTHREAD_RADIO_SPINEL_CUSTOM

comment "⚠  Host OpenThread feature requires CONFIG_OPENTHREAD_ENABLED and CONFIG_OPENTHREAD_RADIO_SPINEL_CUSTOM"
	depends on ESP_HOSTED_HOST_FEAT_OPENTHREAD && !(OPENTHREAD_ENABLED && OPENTHREAD_RADIO_SPINEL_CUSTOM)
```
