## examples/host_hosted_events/sdkconfig.defaults
```kconfig
### Disable transport option to restart on failure, so application will handle transport failures
CONFIG_ESP_HOSTED_TRANSPORT_RESTART_ON_FAILURE=n
```

## examples/host_manage_copro_ext_coex/sdkconfig.defaults
```kconfig
CONFIG_ESP_HOSTED_CP_EXT_COEX=y
CONFIG_ESP_HOSTED_CP_EXT_COEX_ADVANCE=y
CONFIG_FREERTOS_HZ=1000
```

## examples/host_performs_slave_ota/sdkconfig.defaults
```kconfig
# Default configuration for Host Slave OTA Simple Example

# Flash size configuration
CONFIG_ESPTOOLPY_FLASHSIZE_8MB=y
CONFIG_ESPTOOLPY_FLASHSIZE="8MB"

# Force enable ESP-Hosted component
CONFIG_ESP_WIFI_REMOTE_ENABLED=y
CONFIG_ESP_HOSTED_ENABLED=y

# FreeRTOS configuration
CONFIG_FREERTOS_HZ=1000

# Partition table
CONFIG_PARTITION_TABLE_CUSTOM=y
CONFIG_PARTITION_TABLE_CUSTOM_FILENAME="partitions.csv"
CONFIG_PARTITION_TABLE_FILENAME="partitions.csv"
```

## examples/host_shuts_down_slave_to_power_save/sdkconfig.defaults
```kconfig
# Force enable ESP-Hosted component
CONFIG_ESP_WIFI_REMOTE_ENABLED=y
CONFIG_ESP_HOSTED_ENABLED=y

# FreeRTOS configuration
CONFIG_FREERTOS_HZ=1000


# For Heap Tracing (Optional)
CONFIG_PARTITION_TABLE_OFFSET=0x10000
CONFIG_HEAP_TRACING_STANDALONE=y
CONFIG_HEAP_TRACING=y
CONFIG_HEAP_TRACING_STACK_DEPTH=10
CONFIG_ESP_SYSTEM_USE_FRAME_POINTER=y
```

## slave/main/Kconfig.light_sleep
```kconfig
menu "Light Sleep Power Management"
    comment "---- ✓ ESP-Hosted Light sleep allowed to configure ----"
        depends on PM_ENABLE && FREERTOS_USE_TICKLESS_IDLE && (!BT_ENABLED || ESP_PHY_MAC_BB_PD) && (!BT_ENABLED || BTDM_CTRL_MODEM_SLEEP || !IDF_TARGET_ESP32) && (!BT_ENABLED || BT_LE_SLEEP_ENABLE || IDF_TARGET_ESP32)
    comment "---- ✗ ESP-Hosted Light sleep not allowed - Check prerequisites above ---- "
        depends on !PM_ENABLE || !FREERTOS_USE_TICKLESS_IDLE || (BT_ENABLED && !ESP_PHY_MAC_BB_PD && SOC_BT_SUPPORTED)

	comment "⚠️  Prerequisite:	✗ Power Management"
		depends on !PM_ENABLE
	comment "     CONFIG_PM_ENABLE"
		depends on !PM_ENABLE
	comment "     Enable: Component config → Power Management"
		depends on !PM_ENABLE

	comment "⚠️  Prerequisite:	✗ FreeRTOS Tickless Idle"
		depends on !FREERTOS_USE_TICKLESS_IDLE
	comment "     CONFIG_FREERTOS_USE_TICKLESS_IDLE"
		depends on !FREERTOS_USE_TICKLESS_IDLE
	comment "     Enable: Component config → FreeRTOS → Kernel → Tickless Idle"
		depends on !FREERTOS_USE_TICKLESS_IDLE

	comment "⚠️  Prerequisite:	✗ BT Modem Sleep (ESP32)"
		depends on BT_ENABLED && !BTDM_CTRL_MODEM_SLEEP && SOC_BT_SUPPORTED && IDF_TARGET_ESP32
	comment "     CONFIG_BTDM_CTRL_MODEM_SLEEP"
		depends on BT_ENABLED && !BTDM_CTRL_MODEM_SLEEP && SOC_BT_SUPPORTED && IDF_TARGET_ESP32
	comment "     Enable: Component config → Bluetooth → Modem Sleep"
		depends on BT_ENABLED && !BTDM_CTRL_MODEM_SLEEP && SOC_BT_SUPPORTED && IDF_TARGET_ESP32

	comment "⚠️  Prerequisite:	✗ BT LE Sleep (C3/C5/C6/C61/S3/H2)"
		depends on BT_ENABLED && !BT_LE_SLEEP_ENABLE && SOC_BT_SUPPORTED && !IDF_TARGET_ESP32
	comment "     Enable: CONFIG_BT_LE_SLEEP_ENABLE"
		depends on BT_ENABLED && !BT_LE_SLEEP_ENABLE && SOC_BT_SUPPORTED && !IDF_TARGET_ESP32
	comment "     Enable: Component config → Bluetooth → Controller Options → Enable BLE sleep"
		depends on BT_ENABLED && !BT_LE_SLEEP_ENABLE && SOC_BT_SUPPORTED && !IDF_TARGET_ESP32

	comment "⚠️  Prerequisite:	  MAC BB Power Down (BT enabled)"
		depends on BT_ENABLED && !ESP_PHY_MAC_BB_PD && SOC_BT_SUPPORTED
	comment "     CONFIG_ESP_PHY_MAC_BB_PD"
		depends on BT_ENABLED && !ESP_PHY_MAC_BB_PD && SOC_BT_SUPPORTED
	comment "     Enable: Component config → PHY → Power Management → MAC BB power down"
		depends on BT_ENABLED && !ESP_PHY_MAC_BB_PD && SOC_BT_SUPPORTED


	comment "ⓘ  Recommendation:  ⓘ Disable Bluetooth if unused"
		depends on BT_ENABLED && SOC_BT_SUPPORTED
	comment "     Via menuconfig: Component config → Bluetooth → [ ] Bluetooth"
		depends on BT_ENABLED && SOC_BT_SUPPORTED
	comment "     Via API: esp_bt_controller_disable(), esp_bt_controller_deinit(), esp_bt_mem_release()"
		depends on BT_ENABLED && SOC_BT_SUPPORTED

	comment "ⓘ  Recommendation:  ⓘ WiFi Modem Sleep"
		depends on SOC_WIFI_SUPPORTED
	comment "     Enable: Component config → Wi-Fi → WiFi Power Management"
		depends on SOC_WIFI_SUPPORTED
	comment "     Or API: esp_wifi_set_ps(WIFI_PS_MIN_MODEM)"
		depends on SOC_WIFI_SUPPORTED

	comment "ⓘ  Recommendation:  ⓘ WiFi ITWT (Wi-Fi 6) at host & slave"
		depends on SOC_WIFI_HE_SUPPORT
	comment "     Check example,  esp-hosted-mcu/examples/host_wifi_itwt"
		depends on SOC_WIFI_HE_SUPPORT

	config ESP_HOSTED_LIGHT_SLEEP_ENABLE
		bool "Enable light sleep power management"
		depends on PM_ENABLE && FREERTOS_USE_TICKLESS_IDLE && (!BT_ENABLED || ESP_PHY_MAC_BB_PD)
		default n
		help
			Enable light sleep APIs for slave device.

			Light sleep is a low-power mode where the CPU is suspended while peripherals
			like WiFi and Bluetooth can remain operational (if modem sleep is enabled).
			The device can wake from light sleep via external interrupts or timers.

			REQUIREMENTS:
			- Power Management (PM_ENABLE) must be enabled
			- FreeRTOS Tickless Idle (FREERTOS_USE_TICKLESS_IDLE) must be enabled
			- If Bluetooth is enabled, MAC/BB power down (ESP_PHY_MAC_BB_PD) must be enabled

			APIS: slave_light_sleep_init/start/stop()

			RECOMMENDATIONS FOR MAXIMUM POWER SAVINGS:
			- Enable WiFi modem sleep if WiFi is used
			- Enable BT modem sleep on ESP32, or BT LE sleep on other chips
			- Disable unused wireless subsystems (WiFi/BT)
			- Use interrupts instead of polling for event detection

	menu "Light Sleep Parameters"
		depends on ESP_HOSTED_LIGHT_SLEEP_ENABLE

		config ESP_HOSTED_LIGHT_SLEEP_MIN_FREQ_MHZ
			int "Minimum CPU frequency (MHz)"
			default 10 if IDF_TARGET_ESP32
			default 10 if IDF_TARGET_ESP32S2
			default 10 if IDF_TARGET_ESP32S3
			default 10 if IDF_TARGET_ESP32C2
			default 10 if IDF_TARGET_ESP32C3
			default 12 if IDF_TARGET_ESP32C5
			default 10 if IDF_TARGET_ESP32C6
			default 10 if IDF_TARGET_ESP32H2
			range 10 240 if IDF_TARGET_ESP32 || IDF_TARGET_ESP32S2 || IDF_TARGET_ESP32S3 || IDF_TARGET_ESP32C3 || IDF_TARGET_ESP32C6
			range 10 80 if IDF_TARGET_ESP32C2 || IDF_TARGET_ESP32H2
			range 12 96 if IDF_TARGET_ESP32C5
			help
				CPU frequency when idle. Lower = more power saving.

				Supported frequency values and ranges by chipset:
				  ESP32:	10-240 MHz (10, 20, 40, 80, 120, 160, 240)
				  ESP32-S2: 10-240 MHz (10, 20, 40, 80, 120, 160, 240)
				  ESP32-S3: 10-240 MHz (10, 20, 40, 80, 120, 160, 240)
				  ESP32-C2: 10-80 MHz (10, 20, 40, 80)
				  ESP32-C3: 10-240 MHz (10, 20, 40, 80, 160)
				  ESP32-C5: 12-96 MHz (12, 24, 48, 96)
				  ESP32-C6: 10-240 MHz (10, 20, 40, 80, 120, 160)
				  ESP32-H2: 10-80 MHz (10, 20, 40, 80)

				For minimal power consumption, use the lowest supported frequency
				for your target chipset.

		comment "⚠️  Moderate Power Saving config detected"
			depends on !ESP_HOSTED_UNLOAD_BUS_DRIVER_DURING_HOST_SLEEP || !ESP_HOSTED_LIGHT_SLEEP_PERIPHERAL_POWERDOWN
		comment "✓ Maximum Power Saving - All optimizations enabled. Check recommendations to further optimise power"
			depends on ESP_HOSTED_UNLOAD_BUS_DRIVER_DURING_HOST_SLEEP && ESP_HOSTED_LIGHT_SLEEP_PERIPHERAL_POWERDOWN


		comment "ⓘ  Recommendation:	✗ Unload BUS driver during host sleep"
			depends on !ESP_HOSTED_UNLOAD_BUS_DRIVER_DURING_HOST_SLEEP
		comment "     CONFIG_ESP_HOSTED_UNLOAD_BUS_DRIVER_DURING_HOST_SLEEP"
			depends on !ESP_HOSTED_UNLOAD_BUS_DRIVER_DURING_HOST_SLEEP
		comment "     Enable: Example Configuration → Allow host to power save → Unload low level BUS driver during host deep sleep"
			depends on !ESP_HOSTED_UNLOAD_BUS_DRIVER_DURING_HOST_SLEEP

		comment "ⓘ  Recommendation:	✗ Power down Digital Peripheral in light sleep"
			depends on ESP_HOSTED_UNLOAD_BUS_DRIVER_DURING_HOST_SLEEP && !PM_POWER_DOWN_PERIPHERAL_IN_LIGHT_SLEEP
		comment "     CONFIG_PM_POWER_DOWN_PERIPHERAL_IN_LIGHT_SLEEP"
			depends on ESP_HOSTED_UNLOAD_BUS_DRIVER_DURING_HOST_SLEEP && !PM_POWER_DOWN_PERIPHERAL_IN_LIGHT_SLEEP
		comment "     Enable: Component config → Power Management → Power down Digital Peripheral"
			depends on ESP_HOSTED_UNLOAD_BUS_DRIVER_DURING_HOST_SLEEP && !PM_POWER_DOWN_PERIPHERAL_IN_LIGHT_SLEEP

		config ESP_HOSTED_LIGHT_SLEEP_PERIPHERAL_POWERDOWN
			bool "Power down peripherals in light sleep (disables UART console)"
			depends on ESP_HOSTED_UNLOAD_BUS_DRIVER_DURING_HOST_SLEEP && PM_POWER_DOWN_PERIPHERAL_IN_LIGHT_SLEEP
			default n
			help
				Maximum power saving mode. UART console disabled during sleep.

				REQUIREMENTS:
				- Bus driver unload during host sleep must be enabled
				- PM peripheral powerdown must be enabled

				RECOMMENDED FOR:
				- Production deployments
				- Battery-powered applications
				- Scenarios where UART console access during sleep is not needed

				NOTE: Console output will not be available while in light sleep.

	endmenu

endmenu
```

## slave/sdkconfig.defaults
```kconfig
# BT Configuration
CONFIG_BT_ENABLED=y
CONFIG_BT_CONTROLLER_ONLY=y

# OTA
CONFIG_ESPTOOLPY_FLASHSIZE_4MB=y
CONFIG_PARTITION_TABLE_TWO_OTA=y

# OS
CONFIG_FREERTOS_HZ=1000
CONFIG_ESP_WIFI_NVS_ENABLED=y
CONFIG_BOOTLOADER_COMPILER_OPTIMIZATION_PERF=y

#Disable enterprise support by default
CONFIG_ESP_WIFI_ENTERPRISE_SUPPORT=n

##
## Power Management
##
#CONFIG_PM_ENABLE=y
#CONFIG_FREERTOS_USE_TICKLESS_IDLE=y
##
## BLE + Light Sleep: MANDATORY - Enable MAC BB power down
#CONFIG_ESP_PHY_MAC_BB_PD=y
## Without this: Light sleep will be disabled if BT is enabled
##
## Down digital peripherals in light sleep
#CONFIG_PM_POWER_DOWN_PERIPHERAL_IN_LIGHT_SLEEP=y
##
#
## host power save - wake up
#CONFIG_ESP_HOSTED_HOST_POWER_SAVE_ENABLED=y
#CONFIG_ESP_HOSTED_UNLOAD_BUS_DRIVER_DURING_HOST_SLEEP=y
#CONFIG_ESP_HOSTED_LIGHT_SLEEP_ENABLE=y
#CONFIG_ESP_HOSTED_LIGHT_SLEEP_PERIPHERAL_POWERDOWN=y
#CONFIG_ESP_HOSTED_LIGHT_SLEEP_MIN_FREQ_MHZ=10

## Examples
#CONFIG_ESP_HOSTED_EXTRA_EXAMPLES=y
#CONFIG_ESP_HOSTED_COPROCESSOR_EXAMPLE_LIGHT_SLEEP=y
#
#CONFIG_ESP_HOST_DEV_BOARD_P4_C5_CORE=y
```
