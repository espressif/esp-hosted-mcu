## host/features/eh_host_feat_phy_ant/Kconfig.ext
```kconfig
menuconfig ESP_HOSTED_HOST_FEAT_PHY_ANT
	bool "PHY antenna selection"
	default n
	depends on ESP_HOSTED_HOST && ESP_HOSTED_HOST_FEAT_RPC
	depends on ESP_HOSTED_HOST_FEAT_RPC_EXT_V2_READY
	help
	  Configures an external antenna switch on coprocessor GPIOs
	  (eh_host_phy_ant_*). Antenna selection is PHY-level, so it does not
	  need the Wi-Fi feature. The coprocessor must enable
	  ESP_HOSTED_CP_FEAT_PHY_ANT, else every call returns
	  ESP_ERR_NOT_SUPPORTED.

if ESP_HOSTED_HOST_FEAT_PHY_ANT

	config ESP_HOSTED_HOST_FEAT_PHY_ANT_AUTO_INIT
		bool "Auto-initialize PHY antenna feature at boot"
		default y
		depends on ESP_HOSTED_HOST_AUTO_FEAT_INIT
		help
		  When enabled, eh_host_feat_phy_ant_init() runs during the
		  linker-section auto-init walk.

endif # ESP_HOSTED_HOST_FEAT_PHY_ANT

config ESP_HOSTED_HOST_FEAT_PHY_ANT_READY
	bool
	default y if ESP_HOSTED_HOST_FEAT_PHY_ANT && ESP_HOSTED_HOST_FEAT_RPC_READY && ESP_HOSTED_HOST_FEAT_RPC_EXT_V2_READY
```

## host/features/eh_host_feat_rf_cert/Kconfig.ext
```kconfig
menuconfig ESP_HOSTED_HOST_FEAT_RF_CERT
	bool "RF Certification Test"
	default n
	depends on ESP_HOSTED_HOST && ESP_HOSTED_HOST_FEAT_RPC
	depends on ESP_HOSTED_HOST_FEAT_RPC_EXT_V2_READY
	help
	  Gives host callers the coprocessor's PHY certification test APIs
	  over RPC: Wi-Fi and BLE packet TX, RX with packet-error
	  statistics, and carrier-wave tone.

	  The coprocessor must be built with
	  CONFIG_ESP_HOSTED_CP_FEAT_RF_CERT and CONFIG_ESP_PHY_ENABLE_CERT_TEST.
	  Ask the coprocessor at run time with
	  eh_host_phy_cert_query(EH_HOST_PHY_CERT_QUERY_CONFIGURED).

	  For conducted RF measurement only.  Do not enable this in shipped
	  firmware.

if ESP_HOSTED_HOST_FEAT_RF_CERT

	config ESP_HOSTED_HOST_FEAT_RF_CERT_CLI_IDF_NAMES
		bool "Also register the ESP-IDF cert_test command names"
		default n
		help
		  Registers each console command a second time under the name
		  the ESP-IDF phy/cert_test example uses: esp_tx, esp_rx,
		  wifiscwout, cmdstop and the rest, plus the legacy fcc_le_tx
		  and rw_le_rx_per.

		  Turn this on to run a script written against cert_test
		  without editing it.  Off, the console has only the
		  phy_cert_* names, which cannot collide with other features.

	config ESP_HOSTED_HOST_FEAT_RF_CERT_AUTO_INIT
		bool "Auto-initialize RF-cert feature at boot"
		default y
		depends on ESP_HOSTED_HOST_AUTO_FEAT_INIT
		help
		  When enabled, eh_host_feat_rf_cert_init() runs during the
		  linker-section auto-init walk.  This only sets up the host
		  side; it does not put the coprocessor into cert mode.

endif # ESP_HOSTED_HOST_FEAT_RF_CERT

config ESP_HOSTED_HOST_FEAT_RF_CERT_READY
	bool
	default y if ESP_HOSTED_HOST_FEAT_RF_CERT && ESP_HOSTED_HOST_FEAT_RPC_READY && ESP_HOSTED_HOST_FEAT_RPC_EXT_V2_READY
```

## host/mcu/eh_host_mcu_transport/Kconfig.ext
```kconfig
config ESP_HOSTED_HOST_TRANSPORT_MCU
	bool
	default y if ESP_HOSTED_HOST_TYPE_MCU
	default n
	depends on ESP_HOSTED_HOST

config ESP_HOSTED_HOST_TRANSPORT_MCU_READY
	bool
	default y if ESP_HOSTED_HOST_TRANSPORT_MCU

if ESP_HOSTED_HOST_TRANSPORT_MCU
	# y if SDIO is available for the (host SoC, CP target) pair.
	config ESP_HOSTED_HOST_PRIV_SDIO_OPTION
		bool
		default y if (IDF_TARGET_ESP32 || IDF_TARGET_ESP32S3 || IDF_TARGET_ESP32P4) && (ESP_HOSTED_CP_TARGET_ESP32 || ESP_HOSTED_CP_TARGET_ESP32C5 || ESP_HOSTED_CP_TARGET_ESP32C6 || ESP_HOSTED_CP_TARGET_ESP32C61)
		default n

	# y if USB OTG is available for the (host SoC, CP target) pair.
	# warning: verify that the SOC has enough USB endpoints to support the following
	# combination before enabling as a USB OTG Host or Device:
	# - USB-CDC-ACM
	# - USB-BTH
	# - USB-Networking (RNDIS/ECM/NCM)
	# Currently, only the P4 and S31 have enough USB endpoints for this combination.
	# S2 and S3 are enabled ONLY for USB OTG testing purposes.
	config ESP_HOSTED_HOST_PRIV_USB_OTG_OPTION
		bool
		default y if (IDF_TARGET_ESP32P4) && (ESP_HOSTED_CP_TARGET_ESP32S31 || ESP_HOSTED_CP_TARGET_ESP32S2 || ESP_HOSTED_CP_TARGET_ESP32S3)
		default n

	choice ESP_HOSTED_HOST_TRANSPORT_BUS
		prompt "Communication bus (co-processor <== bus ==> host)"
		default ESP_HOSTED_HOST_TRANSPORT_BUS_SDIO if ESP_HOSTED_HOST_PRIV_SDIO_OPTION
		default ESP_HOSTED_HOST_TRANSPORT_BUS_SPI
		help
		  Selects which bus peripheral drives the host→CP link.
		  Pin / clock / baud defaults for the chosen bus live in the
		  corresponding Kconfig.host.<bus> sub-file.  SDIO is the
		  preferred default when both ends support it; falls back to
		  SPI Full-duplex otherwise.

		config ESP_HOSTED_HOST_TRANSPORT_BUS_SPI
			bool "SPI Full Duplex"
		config ESP_HOSTED_HOST_TRANSPORT_BUS_SDIO
			bool "SDIO"
			depends on ESP_HOSTED_HOST_PRIV_SDIO_OPTION
		config ESP_HOSTED_HOST_TRANSPORT_BUS_SPI_HD
			bool "SPI Half Duplex"
		config ESP_HOSTED_HOST_TRANSPORT_BUS_UART
			bool "UART"
			# A flash-resident ISR stalls during flash ops and the 128-byte RX FIFO overflows.
			select UART_ISR_IN_IRAM if !RINGBUF_PLACE_ISR_FUNCTIONS_INTO_FLASH
		config ESP_HOSTED_HOST_TRANSPORT_BUS_OTG_HOST
			bool "USB (OTG) (as Host) (Experimental)"
			depends on ESP_HOSTED_HOST_PRIV_USB_OTG_OPTION
			help
				Host acts as USB OTG Host. ESP-Hosted frames, including RPC,
				are carried over CDC-ACM.

	endchoice

	# _READY = bus selected AND parent transport compiled-in. Gates source pulls.
	config ESP_HOSTED_HOST_TRANSPORT_BUS_SPI_READY
		bool
		default y if ESP_HOSTED_HOST_TRANSPORT_BUS_SPI && ESP_HOSTED_HOST_TRANSPORT_MCU_READY
	config ESP_HOSTED_HOST_TRANSPORT_BUS_SDIO_READY
		bool
		default y if ESP_HOSTED_HOST_TRANSPORT_BUS_SDIO && ESP_HOSTED_HOST_TRANSPORT_MCU_READY
	config ESP_HOSTED_HOST_TRANSPORT_BUS_SPI_HD_READY
		bool
		default y if ESP_HOSTED_HOST_TRANSPORT_BUS_SPI_HD && ESP_HOSTED_HOST_TRANSPORT_MCU_READY
	config ESP_HOSTED_HOST_TRANSPORT_BUS_UART_READY
		bool
		default y if ESP_HOSTED_HOST_TRANSPORT_BUS_UART && ESP_HOSTED_HOST_TRANSPORT_MCU_READY
	config ESP_HOSTED_HOST_TRANSPORT_BUS_OTG_HOST_READY
		bool
		default y if ESP_HOSTED_HOST_TRANSPORT_BUS_OTG_HOST && ESP_HOSTED_HOST_TRANSPORT_MCU_READY

	orsource "Kconfig.host.spi"
	orsource "Kconfig.host.sdio"
	orsource "Kconfig.host.spi_hd"
	orsource "Kconfig.host.uart"
	orsource "Kconfig.host.usb_otg_host"

	menu "Transport Test"
		config ESP_HOSTED_RAW_THROUGHPUT_TRANSPORT
			bool
			default y
			help
				RawTP support is always compiled in for MCU hosts. The test
				remains idle until the host CLI starts it at runtime; there is
				no boot-time auto-start direction.

		config ESP_HOSTED_RAW_TP_REPORT_INTERVAL
			int "RawTP: periodic duration to report stats accumulated"
			default 1

		config ESP_HOSTED_RAW_TP_HOST_TO_ESP_PKT_LEN
			int "RawTP: Host to ESP packet size"
			default 1460
	endmenu

	menu "Transport Debug"
		config ESP_HOSTED_HOST_PKT_STATS
			bool "Transport packet stats"
			depends on ESP_HOSTED_HOST_TRANSPORT_BUS_SDIO || ESP_HOSTED_HOST_TRANSPORT_BUS_UART
			default n
			help
				Log the host datapath counters at regular intervals. The
				counters show TX in, out and discards, RX in and out, credit
				stalls.

				To find frame loss between the network stack and the CP,
				compare these counters with the CP packet stats.

				This option is a debug aid. Keep it disabled in production
				builds.

		config ESP_HOSTED_HOST_PKT_STATS_INTERVAL_SEC
			depends on ESP_HOSTED_HOST_PKT_STATS
			int "Packet stats reporting interval (sec)"
			default 30
	endmenu

endif
```

## host/mcu/eh_host_mcu_transport/Kconfig.host.usb_otg_host
```kconfig
# SPDX-License-Identifier: Apache-2.0
# USB OTG Host transport configuration.

if ESP_HOSTED_HOST_TRANSPORT_BUS_OTG_HOST

	menu "USB OTG Host Configuration (Experimental)"

		choice ESP_HOSTED_HOST_USB_STACK
			prompt "USB Host stack"
			default ESP_HOSTED_HOST_USB_STACK_CDC_ACM
			help
				Selects the USB host implementation that enumerates the
				coprocessor CDC-ACM interface.

			config ESP_HOSTED_HOST_USB_STACK_CDC_ACM
				bool "ESP-IDF usb_host_cdc_acm"
				help
					Espressif USB Host Library and the usb_host_cdc_acm class driver.

			config ESP_HOSTED_HOST_USB_STACK_CHERRYUSB
				bool "CherryUSB"
				select CHERRYUSB
				select CHERRYUSB_HOST
				select CHERRYUSB_HOST_CDC_ACM
				help
					CherryUSB host stack (DWC2) and its CDC-ACM serial driver.

		endchoice

		config ESP_HOSTED_HOST_USB_RNDIS
			bool "USB RNDIS data plane"
			depends on ESP_HOSTED_HOST_USB_STACK_CDC_ACM && IDF_TARGET_ESP32P4
			# Present, but not selectable until the RNDIS data plane is ready.
			depends on n
			default n
			help
				Use the ESP-IoT-Solution RNDIS host driver for STA and AP
				Ethernet frames. CDC-ACM remains the control plane for RPC,
				HCI, power-save, and flow-control frames. Enable the matching
				EH_TRANSPORT_CP_USB_OTG_DEVICE_RNDIS option on the coprocessor.

		config ESP_HOSTED_HOST_RESET_GPIO
			int "Slave reset GPIO (RST/EN line)"
			default -1
			range -1 100
			help
				GPIO used to reset the coprocessor during connect_to_slave.
				Set to -1 if reset line is not connected.

		config ESP_HOSTED_HOST_USB_CONNECTION_TIMEOUT_MS
			int "USB device connection timeout (ms)"
			default 5000
			range 500 30000
			help
				Time to wait for the CDC-ACM device to be enumerated and opened.

		config ESP_HOSTED_HOST_USB_VID
			hex "USB Vendor ID (VID)"
			default 0x303A if ESP_HOSTED_CP_TARGET_ESP32S31
			default 0x0000
			range 0x0000 0xFFFF
			help
				Vendor ID used to identify the coprocessor. 0x0000 matches
				any vendor (CDC_HOST_ANY_VID). ESP32-S31 defaults to 0x303A.

		config ESP_HOSTED_HOST_USB_PID
			hex "USB Product ID (PID)"
			default 0x4001 if ESP_HOSTED_CP_TARGET_ESP32S31
			default 0x0000
			range 0x0000 0xFFFF
			help
				Product ID used to identify the coprocessor. 0x0000 matches
				any product (CDC_HOST_ANY_PID). ESP32-S31 defaults to 0x4001.

		config ESP_HOSTED_HOST_USB_TX_Q_SIZE
			int "USB Host TX queue size"
			# Present, but not selectable until a host TX queue exists.
			depends on n
			default 20
			range 4 100
			help
				Number of TX buffers for the CDC-ACM host transport.

		config ESP_HOSTED_HOST_USB_RX_Q_SIZE
			int "USB Host RX queue size"
			default 6
			range 4 100
			help
				Number of host RX buffers. Each buffer is one maximum USB frame.

		config ESP_HOSTED_HOST_USB_OUT_BUF_SIZE
			int "USB CDC OUT buffer size (bytes)"
			default 2048
			range 512 8192
			help
				Maximum USB bulk OUT transfer size.

		config ESP_HOSTED_HOST_USB_IN_BUF_SIZE
			int "USB CDC IN buffer size (bytes, 0 = MPS)"
			default 0
			range 0 8192
			help
				Maximum USB bulk IN transfer size. 0 uses endpoint Max Packet Size (MPS).

		config ESP_HOSTED_HOST_USB_RX_TASK_STACK
			int "USB RX task stack size"
			default 4096
			range 2048 16384
			help
				Stack size for the dedicated USB RX frame processing task.

		config ESP_HOSTED_HOST_USB_RX_TASK_PRIO
			int "USB RX task priority"
			default 22
			range 1 25
			help
				Priority of the USB RX frame processing task.

		config ESP_HOSTED_HOST_USB_RNDIS_TX_Q_SIZE
			int "USB RNDIS TX queue size"
			depends on ESP_HOSTED_HOST_USB_RNDIS
			default 20
			range 4 100
			help
				Maximum number of Ethernet frames accepted from lwIP while the
				RNDIS bulk OUT worker is busy. A full queue returns a TX error
				to lwIP so it backs off instead of overrunning the coprocessor.

		config ESP_HOSTED_HOST_USB_RNDIS_TX_TASK_STACK
			int "USB RNDIS TX task stack size"
			depends on ESP_HOSTED_HOST_USB_RNDIS
			default 4096
			range 2048 16384

		config ESP_HOSTED_HOST_USB_RNDIS_TX_TASK_PRIO
			int "USB RNDIS TX task priority"
			depends on ESP_HOSTED_HOST_USB_RNDIS
			default 22
			range 1 25

	endmenu

endif
```

## tests/fw/cp_aux_loopback/Kconfig.projbuild
```kconfig
config EH_TEST_CP_AUX_LOOPBACK
	bool "Echo ESP_AUX_OT frames back to the host"
	default n
	help
		Test-only. Off unless a test enables it.
```

## tests/fw/cp_deinit_init_cycles/Kconfig.projbuild
```kconfig
menu "Test harness: CP deinit/init cycles"

config EH_TEST_CP_DEINIT_INIT_CYCLES
    int "deinit/init cycles to run on the cycles-start command"
    default 20
    range 0 1000
    help
        Run this many deinit and init cycles on a temporary task when the
        cycles-start console command arrives, printing free heap once per cycle
        at the same point. 0 compiles the cycles out.

endmenu
```

## tests/fw/host_aux_loopback/Kconfig.projbuild
```kconfig
config EH_TEST_HOST_AUX_LOOPBACK
	bool "Drive ESP_AUX_OT frames against the CP echo"
	default n
	help
		Test-only. Off unless a test enables it.
```

## tests/fw/host_stack_place/mcu_host/main/Kconfig.projbuild
```kconfig
menu "Stack placement test"
config EH_TEST_BSS_PAD_BYTES
    int "Static .bss pad (bytes)"
    default 0
    help
        Size of an unused static array. A larger .bss leaves less low internal
        RAM in the heap at boot.
endmenu
```

## tests/fw/host_stack_place/mcu_host/sdkconfig.defaults
```kconfig
CONFIG_ESP_HOSTED=y
CONFIG_ESP_HOSTED_AUTO_CALL_INIT_BEFORE_APP_MAIN=y
CONFIG_ESP_HOSTED_HOST_FEAT_RPC=y
CONFIG_ESP_HOSTED_HOST_FEAT_RPC_EXT_V2=y
CONFIG_ESP_HOSTED_HOST_FEAT_SYSTEM=y
CONFIG_ESP_SYSTEM_ALLOW_RTC_FAST_MEM_AS_HEAP=y
CONFIG_FREERTOS_HZ=1000
```

## tests/fw/host_super/bluedroid/sdkconfig.defaults
```kconfig
# Super host, Bluedroid family (IDF builds one BT host stack per image).
CONFIG_ESP_HOSTED=y
# The dispatcher starts ESP-Hosted after the scenario is chosen.
CONFIG_ESP_HOSTED_AUTO_CALL_INIT_BEFORE_APP_MAIN=n

CONFIG_ESP_HOSTED_HOST_FEAT_RPC=y
CONFIG_ESP_HOSTED_HOST_FEAT_RPC_EXT_V2=y
CONFIG_ESP_HOSTED_HOST_FEAT_SYSTEM=y
CONFIG_ESP_HOSTED_HOST_FEAT_WIFI=y
CONFIG_ESP_HOSTED_HOST_FEAT_HEARTBEAT=y
CONFIG_ESP_HOSTED_HOST_FEAT_GPIO_EXP=y
CONFIG_ESP_HOSTED_HOST_FEAT_CP_EXT_COEX=y
CONFIG_ESP_HOSTED_HOST_FEAT_MEM_MONITOR=y
CONFIG_ESP_HOSTED_HOST_FEAT_PEER_DATA=y
CONFIG_ESP_HOSTED_HOST_FEAT_BT=y
CONFIG_ESP_WIFI_REMOTE_LIBRARY_HOSTED=y
CONFIG_SLAVE_IDF_TARGET_ESP32C6=y
CONFIG_ESP_HOSTED_CP_TARGET_ESP32C6=y

CONFIG_BT_ENABLED=y
CONFIG_BT_CONTROLLER_DISABLED=y
CONFIG_BT_NIMBLE_ENABLED=n
CONFIG_BT_BLUEDROID_ENABLED=y
CONFIG_BT_BLE_42_FEATURES_SUPPORTED=y
CONFIG_BT_BLE_50_FEATURES_SUPPORTED=n
CONFIG_BT_LE_50_FEATURE_SUPPORT=n

CONFIG_ESP_WIFI_SSID="myssid"
CONFIG_ESP_WIFI_PASSWORD="mypassword"
CONFIG_ESP_WIFI_IRAM_OPT=n

CONFIG_FREERTOS_HZ=1000
CONFIG_ESP32P4_SELECTS_REV_LESS_V3=n
CONFIG_ESP32P4_REV_MIN_301=y
CONFIG_BOOTLOADER_SKIP_VALIDATE_ON_POWER_ON=y

CONFIG_ESPTOOLPY_FLASHSIZE_8MB=y
CONFIG_PARTITION_TABLE_CUSTOM=y
CONFIG_PARTITION_TABLE_CUSTOM_FILENAME="partitions.csv"
CONFIG_PARTITION_TABLE_OFFSET=0x10000
```
